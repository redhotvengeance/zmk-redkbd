## config/west.yml
```yaml
manifest:
  remotes:
    - name: zmkfirmware
      url-base: https://github.com/zmkfirmware
    - name: redhotvengeance
      url-base: https://github.com/redhotvengeance
  projects:
    - name: zmk
      remote: zmkfirmware
      revision: main
      import: app/west.yml
    - name: redkbd-zmk-module
      remote: redhotvengeance
      revision: main
  self:
    path: config
```
